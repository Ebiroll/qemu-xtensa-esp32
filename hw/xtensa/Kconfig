## hw/xtensa/Kconfig
```kconfig
config XTENSA_SIM
    bool

config XTENSA_XTFPGA
    bool
    select OPENCORES_ETH
    select PFLASH_CFI01
    select SERIAL

config ESP32
    bool
    select SSI
    select SSI_M25P80
    select UNIMP
    select OPENCORES_ETH
```
